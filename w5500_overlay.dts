/dts-v1/;
/plugin/;
/ {
	compatible = "brcm,bcm2835";

	fragment@0 {
		target = <&spidev0>;
		__overlay__ {
			status = "disabled";
		};
	};
		
	fragment@1 {
		target = <&spi0>;
		__overlay__ {
			status = "okay";
			#address-cells = <1>;
			#size-cells = <0>;

			w5500: w5500@0 {
				compatible = "wiznet,w5500";
				reg = <0x0>;
				spi-max-frequency = <10000000>;
				status = "okay";
				int-gpios = <&gpio 25 0>;
			};
		};
	};
};